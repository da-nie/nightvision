#include "ST7735S.h"

//контакты дисплея
#define ST7735_GPIO_PIN_SCK   GPIO_PIN_1
#define ST7735_GPIO_PIN_SDA   GPIO_PIN_2
#define ST7735_GPIO_PIN_AD    GPIO_PIN_3
#define ST7735_GPIO_PIN_RESET GPIO_PIN_8
#define ST7735_GPIO_PIN_CS    GPIO_PIN_15

volatile static long PrintYPosition=0;//позиция вывода строки

const unsigned char Font8x14[224][14]=
{
 { 0x00, 0x00, 0x00, 0x00, 0x00, 0x00, 0x00, 0x00, 0x00, 0x00, 0x00, 0x00, 0x00, 0x00},//' '=0x20 
 { 0x00, 0x10, 0x38, 0x38, 0x38, 0x10, 0x10, 0x10, 0x00, 0x10, 0x10, 0x00, 0x00, 0x00},//'!'=0x21 
 { 0x00, 0x66, 0x66, 0x22, 0x44, 0x00, 0x00, 0x00, 0x00, 0x00, 0x00, 0x00, 0x00, 0x00},//'"'=0x22 
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 { 0x00, 0x00, 0x00, 0x00, 0x7E, 0xCC, 0xCC, 0xFC, 0x6C, 0xCC, 0xCE, 0x00, 0x00, 0x00}
};


//----------------------------------------------------------------------------------------------------
//инициализация GPIO
//----------------------------------------------------------------------------------------------------
void ST7735S_GPIOInit(void)
{
 //дисплей подключен к порту A
 //A1-SCK
 //A2-SDA
 //A3-AD
 //A8-RESET
 //A15-CS		
 __HAL_RCC_GPIOA_CLK_ENABLE();
	
 //GPIO_Pin – номера выводов, которые конфигурируются. Пример для нескольких выводов:
 //GPIO_InitStructure.GPIO_Pin = GPIO_Pin_0 | GPIO_Pin_1 | GPIO_Pin_2;
 //GPIO_Speed – задает скорость для выбранных выводов.
 //GPIO_Mode – задает режим работы выводов. 

 //настраиваем параметры порта
 GPIO_InitTypeDef ST7735S_GPIO_Init;
 ST7735S_GPIO_Init.Mode=GPIO_MODE_OUTPUT_PP;
 ST7735S_GPIO_Init.Pull=GPIO_NOPULL;
 ST7735S_GPIO_Init.Pin=ST7735_GPIO_PIN_SCK|ST7735_GPIO_PIN_SDA|ST7735_GPIO_PIN_AD|ST7735_GPIO_PIN_RESET|ST7735_GPIO_PIN_CS;
 ST7735S_GPIO_Init.Speed=GPIO_SPEED_FREQ_VERY_HIGH;
 HAL_GPIO_Init(GPIOA,&ST7735S_GPIO_Init);	
}
//----------------------------------------------------------------------------------------------------
//включить SDA
//----------------------------------------------------------------------------------------------------
void ST7735S_SetSDA(void)
{
 HAL_GPIO_WritePin(GPIOA,ST7735_GPIO_PIN_SDA,GPIO_PIN_SET);
}
//----------------------------------------------------------------------------------------------------
//отключить SDA
//----------------------------------------------------------------------------------------------------
void ST7735S_ResetSDA(void)
{
 HAL_GPIO_WritePin(GPIOA,ST7735_GPIO_PIN_SDA,GPIO_PIN_RESET);
}
//----------------------------------------------------------------------------------------------------
//включить SCK
//----------------------------------------------------------------------------------------------------
void ST7735S_SetSCK(void)
{
 HAL_GPIO_WritePin(GPIOA,ST7735_GPIO_PIN_SCK,GPIO_PIN_SET);
}
//----------------------------------------------------------------------------------------------------
//отключить SCK
//----------------------------------------------------------------------------------------------------
void ST7735S_ResetSCK(void)
{
 HAL_GPIO_WritePin(GPIOA,ST7735_GPIO_PIN_SCK,GPIO_PIN_RESET);
}

//----------------------------------------------------------------------------------------------------
//включить AD
//----------------------------------------------------------------------------------------------------
void ST7735S_SetAD(void)
{
 HAL_GPIO_WritePin(GPIOA,ST7735_GPIO_PIN_AD,GPIO_PIN_SET);
}
//----------------------------------------------------------------------------------------------------
//отключить AD
//----------------------------------------------------------------------------------------------------
void ST7735S_ResetAD(void)
{
 HAL_GPIO_WritePin(GPIOA,ST7735_GPIO_PIN_AD,GPIO_PIN_RESET);
}

//----------------------------------------------------------------------------------------------------
//включить RESET
//----------------------------------------------------------------------------------------------------
void ST7735S_SetRESET(void)
{
 HAL_GPIO_WritePin(GPIOA,ST7735_GPIO_PIN_RESET,GPIO_PIN_SET);
}
//----------------------------------------------------------------------------------------------------
//отключить RESET
//----------------------------------------------------------------------------------------------------
void ST7735S_ResetRESET(void)
{
 HAL_GPIO_WritePin(GPIOA,ST7735_GPIO_PIN_RESET,GPIO_PIN_RESET);
}

//----------------------------------------------------------------------------------------------------
//включить CS
//----------------------------------------------------------------------------------------------------
void ST7735S_SetCS(void)
{
 HAL_GPIO_WritePin(GPIOA,ST7735_GPIO_PIN_CS,GPIO_PIN_SET);
}
//----------------------------------------------------------------------------------------------------
//отключить CS
//----------------------------------------------------------------------------------------------------
void ST7735S_ResetCS(void)
{
 HAL_GPIO_WritePin(GPIOA,ST7735_GPIO_PIN_CS,GPIO_PIN_RESET);
}


//----------------------------------------------------------------------------------------------------
//передать байт по программному SPI (SPI срабатывает по низкому уровню сигнала SCK!)
//----------------------------------------------------------------------------------------------------
unsigned char ST7735S_SPITransmitt(unsigned char byte)
{
 unsigned char response=0;
 for (unsigned char i=0;i<8;i++,byte=byte<<1)
 {
  response=response<<1;
  if (byte&128) ST7735S_SetSDA();
           else ST7735S_ResetSDA();
  ST7735S_ResetSCK();	
  //if (LPT_GetACKState()==true) response|=1;
  ST7735S_SetSCK();
 }
 return(response);
}
//------------------------------------------------------------------------------
//отправить байт дисплею
//------------------------------------------------------------------------------
void ST7735S_SendByte(unsigned char byte,bool command)
{
 ST7735S_ResetCS();
 if (command==true) ST7735S_ResetAD();
               else ST7735S_SetAD();
 ST7735S_SetSCK();
 ST7735S_SPITransmitt(byte);
 ST7735S_SetCS();
}
//------------------------------------------------------------------------------
//отправить слово 16 бит дисплею
//------------------------------------------------------------------------------
void ST7735S_SendShort(unsigned short value)
{
 ST7735S_SendByte((value>>8)&0xff,false); 
 ST7735S_SendByte(value&0xff,false);
}

//----------------------------------------------------------------------------------------------------
//инициализация дисплея
//----------------------------------------------------------------------------------------------------
void ST7735S_Init(void)
{
 ST7735S_GPIOInit();
 HAL_Delay(100);
 ST7735S_ResetRESET();
 HAL_Delay(10);
 ST7735S_SetRESET();
 HAL_Delay(10);

 unsigned int i=0;
 ST7735S_SendByte(0xB9,true);//SETEXTC
 ST7735S_SendByte(0xFF,false);
 ST7735S_SendByte(0x83,false);
 ST7735S_SendByte(0x53,false);

 ST7735S_SendByte(0xB0,true);//RADJ
 ST7735S_SendByte(0x3C,false);
 ST7735S_SendByte(0x01,false);

 ST7735S_SendByte(0xB6,true);//VCOM
 ST7735S_SendByte(0x94,false);
 ST7735S_SendByte(0x6C,false);
 ST7735S_SendByte(0x50,false);

 ST7735S_SendByte(0xB1,true);//PWR
 ST7735S_SendByte(0x00,false);
 ST7735S_SendByte(0x01,false);
 ST7735S_SendByte(0x1B,false);
 ST7735S_SendByte(0x03,false);
 ST7735S_SendByte(0x01,false);
 ST7735S_SendByte(0x08,false);
 ST7735S_SendByte(0x77,false);
 ST7735S_SendByte(0x89,false);

 ST7735S_SendByte(0xE0,true); //Gamma setting for tpo Panel
 ST7735S_SendByte(0x50,false);
 ST7735S_SendByte(0x77,false);
 ST7735S_SendByte(0x40,false);
 ST7735S_SendByte(0x08,false);
 ST7735S_SendByte(0xBF,false);
 ST7735S_SendByte(0x00,false);
 ST7735S_SendByte(0x03,false);
 ST7735S_SendByte(0x0F,false);
 ST7735S_SendByte(0x00,false);
 ST7735S_SendByte(0x01,false);
 ST7735S_SendByte(0x73,false);
 ST7735S_SendByte(0x00,false);
 ST7735S_SendByte(0x72,false);
 ST7735S_SendByte(0x03,false);
 ST7735S_SendByte(0xB0,false);
 ST7735S_SendByte(0x0F,false);
 ST7735S_SendByte(0x08,false);
 ST7735S_SendByte(0x00,false);
 ST7735S_SendByte(0x0F,false);

 ST7735S_SendByte(0x3A,true);
 ST7735S_SendByte(0x05,false);//05

 ST7735S_SendByte(0x36,true);
 ST7735S_SendByte(0xC0,false);//83  //0B

 ST7735S_SendByte(0x11,true);//SLPOUT
 HAL_Delay(10);

 ST7735S_SendByte(0x29,true);//display on
 HAL_Delay(10);

 ST7735S_SendByte(0x2D,true);//Look up table
 for(i=0;i<32;i++) ST7735S_SendByte(2*i,false); //Red
 for(i=0;i<64;i++) ST7735S_SendByte(1*i,false); //Green
 for(i=0;i<32;i++) ST7735S_SendByte(2*i,false); //Blue

 ST7735S_SendByte(0x2c,true);	
 
 HAL_Delay(100);
}


//------------------------------------------------------------------------------
//задать область вывода графики
//------------------------------------------------------------------------------
void ST7735S_SetArea(unsigned char x1, unsigned char y1, unsigned char x2, unsigned char y2)
{
 ST7735S_SendByte(0x2a,true);
 ST7735S_SendByte(0,false);
 ST7735S_SendByte(y1,false);
 ST7735S_SendByte(0,false);
 ST7735S_SendByte(y2,false);
 ST7735S_SendByte(0x2b,true);
 ST7735S_SendByte(0,false);
 ST7735S_SendByte(x1,false);
 ST7735S_SendByte(0,false);
 ST7735S_SendByte(x2,false);
 ST7735S_SendByte(0x2c,true);
}
//------------------------------------------------------------------------------
//передать цвет точки
//------------------------------------------------------------------------------
void ST7735S_OutColor(unsigned short color)
{
 ST7735S_SendShort(color);
}
//------------------------------------------------------------------------------
//вывести один пиксель
//------------------------------------------------------------------------------
void ST7735S_PutPixel(unsigned char x, unsigned char y, unsigned short color)
{
 ST7735S_SetArea((160-x),y,(160-x),y);
 ST7735S_OutColor(color);
}

//----------------------------------------------------------------------------------------------------
//вывод символа в позицию
//----------------------------------------------------------------------------------------------------
void ST7735S_PutSymbol(long x,long y,char symbol,unsigned short color)
{ 
 unsigned char s=(unsigned char)(symbol);
 if (s<=32) return;
 s-=32;
 if (s>223) return;
 //рисуем символ
 for(long ys=0;ys<FONT_HEIGHT;ys++)
 {
  unsigned char byte=Font8x14[s][ys];
  unsigned char mask=128;
  for(long xs=0;xs<FONT_WIDTH;xs++,mask>>=1)
  {   
   if (x+xs<0 || x+xs>=SCREEN_WIDTH) continue;
   if (y+ys<0 || y+ys>=SCREEN_HEIGHT) continue;
   if (byte&mask) ST7735S_PutPixel(x+xs,y+ys,color);
  }
 }
}

//----------------------------------------------------------------------------------------------------
//вывод строчки в позицию
//----------------------------------------------------------------------------------------------------
void ST7735S_PutString(long x,long y,const char *string,unsigned short color)
{
 long s=0;	
 while((*string)!=0)
 {
  ST7735S_PutSymbol(x,y,*string,color);
	x+=FONT_WIDTH;  
	string++;
	s++;
	if (s>20) break;
 }
}

//----------------------------------------------------------------------------------------------------
//вывести текст в текущую позицию
//----------------------------------------------------------------------------------------------------
void ST7735S_Print(const char *string,unsigned short color)
{
 if (PrintYPosition+FONT_HEIGHT>=SCREEN_HEIGHT) ST7735S_Clear();
 ST7735S_PutString(0,PrintYPosition,string,color);
 PrintYPosition+=FONT_HEIGHT;
}
//----------------------------------------------------------------------------------------------------
//сбросить текущую позицию
//----------------------------------------------------------------------------------------------------
void ST7735S_Clear(void)
{
 PrintYPosition=0;
 ST7735S_SetArea(0,0,160,128);
 for(long x=0;x<160;x++)
 {
  for(long y=0;y<128;y++)
  {  
   ST7735S_OutColor(ST7735S_BLACK);
  }
 }	
}





